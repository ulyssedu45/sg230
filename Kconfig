## Kconfig
```kconfig
## SPDX-License-Identifier: GPL-2.0-only

if VENDOR_SOPHOS

choice
	prompt "Mainboard model"

source "src/mainboard/sophos/*/Kconfig.name"

endchoice

source "src/mainboard/sophos/*/Kconfig"

config MAINBOARD_VENDOR
	default "Sophos"

config MAINBOARD_FAMILY
	string
	default MAINBOARD_PART_NUMBER

endif # VENDOR_SOPHOS
```

## drivers/Kconfig
```kconfig
## SPDX-License-Identifier: GPL-2.0-only

menu "Drivers"

source "drivers/usb/Kconfig"

endmenu
```

## drivers/usb/acpi/Kconfig
```kconfig
## SPDX-License-Identifier: GPL-2.0-only

config DRIVERS_USB_ACPI
	bool "USB ACPI Device Support"
	depends on HAVE_ACPI_TABLES
	help
	  This driver provides ACPI support for USB devices, including
	  _UPC (USB Port Capabilities) and _PLD (Physical Location of Device)
	  generation for USB ports. Required for proper USB device enumeration
	  in ACPI-aware operating systems.
```

## sg230r2/Kconfig
```kconfig
# SPDX-License-Identifier: GPL-2.0-only

if BOARD_SOPHOS_SG230_REV2

config BOARD_SPECIFIC_OPTIONS
	def_bool y
	select BOARD_ROMSIZE_KB_16384
	select DRIVERS_USB_ACPI
	select HAVE_ACPI_RESUME
	select HAVE_ACPI_TABLES
	select INTEL_GMA_HAVE_VBT
	select MAINBOARD_HAS_LIBGFXINIT
	select SKYLAKE_SOC_PCH_H
	select SOC_INTEL_KABYLAKE
	select USE_LEGACY_8254_TIMER
	select SUPERIO_NUVOTON_NCT6779D

config MAINBOARD_DIR
	default "sophos/sg230r2"

config MAINBOARD_PART_NUMBER
	default "SG230 Rev 2"

config DIMM_MAX
	int
	default 2

config DIMM_SPD_SIZE
	int
	default 256

config ONBOARD_BEEP
	bool
	default y

config POST_IO
	bool
	default y

config MAINBOARD_POWER_LIMITS_OVERRIDE
	bool
	default y

endif # BOARD_SOPHOS_SG230_REV2
```

## sg230r2/Kconfig.name
```kconfig
# SPDX-License-Identifier: GPL-2.0-only

config BOARD_SOPHOS_SG230_REV2
	bool "SG230 Rev 2"
```

## sg230r2/sg230r2/Kconfig
```kconfig
# SPDX-License-Identifier: GPL-2.0-only

if BOARD_SOPHOS_SG230_REV2

config BOARD_SPECIFIC_OPTIONS
	def_bool y
	select BOARD_ROMSIZE_KB_16384
	select DRIVERS_USB_ACPI
	select HAVE_ACPI_RESUME
	select HAVE_ACPI_TABLES
	select DRIVERS_OPTION_CFR_ENABLED if PAYLOAD_EDK2 && SMMSTORE
	select INTEL_GMA_HAVE_VBT
	select MAINBOARD_HAS_LIBGFXINIT
	select SKYLAKE_SOC_PCH_H
	select SOC_INTEL_KABYLAKE
	select USE_LEGACY_8254_TIMER
	select SUPERIO_NUVOTON_NCT6779D

config MAINBOARD_DIR
	default "sophos/sg230r2"

config MAINBOARD_PART_NUMBER
	default "SG230 Rev 2"

config DIMM_MAX
	int
	default 2

config DIMM_SPD_SIZE
	int
	default 256

config BEEP_ON_BOOT
	bool "Beep on successful boot"
	default y
	help
	  Make the platform beep using the PC speaker in final coreboot phase.
	  May serve as a useful indicator in headless mode that platform is
	  properly booting.
	  
endif # BOARD_SOPHOS_SG230_REV2
```
