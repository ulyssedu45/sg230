## defconfig
```kconfig
CONFIG_VENDOR_SOPHOS=y
CONFIG_CBFS_SIZE=0x600000
# CONFIG_PCIEXP_ASPM is not set
# CONFIG_PCIEXP_L1_SUB_STATE is not set
# CONFIG_PCIEXP_CLK_PM is not set
# CONFIG_DRIVERS_INTEL_WIFI is not set
CONFIG_EDK2_BOOT_TIMEOUT=5
CONFIG_HAVE_IFD_BIN=y
CONFIG_EDK2_BOOT_MANAGER_ESCAPE=y
# CONFIG_EDK2_FULL_SCREEN_SETUP is not set
CONFIG_BOARD_SOPHOS_SG230_REV2=y
CONFIG_MAINBOARD_SUPPORTS_COFFEELAKE_CPU=y
CONFIG_ALWAYS_ALLOW_ABOVE_4G_ALLOCATION=y
CONFIG_INTEL_KEYLOCKER=y
CONFIG_SOC_INTEL_COMMON_BLOCK_PRMRR_SIZE_64MB=y
CONFIG_HAVE_ME_BIN=y
CONFIG_PCIEXP_SUPPORT_RESIZABLE_BARS=y
# CONFIG_DRIVERS_MTK_WIFI is not set
CONFIG_SECURITY_CLEAR_DRAM_ON_REGULAR_BOOT=y
CONFIG_DEFAULT_CONSOLE_LOGLEVEL_6=y
CONFIG_PAYLOAD_EDK2=y
CONFIG_EDK2_TAG_OR_REV="origin/uefipayload_2511"
# CONFIG_EDK2_PS2_SUPPORT is not set
CONFIG_EDK2_SD_MMC_TIMEOUT=5
CONFIG_EDK2_SERIAL_SUPPORT=y
CONFIG_EDK2_DISABLE_TPM=y
```

## sg210r3/Kconfig.name
```kconfig
# SPDX-License-Identifier: GPL-2.0-only

config BOARD_SOPHOS_SG210_REV3
	bool "SG210 Rev 3"

config BOARD_SOPHOS_SG230_REV2
	bool "SG230 Rev 2"

config BOARD_SOPHOS_XG210_REV3
	bool "XG210 Rev 3"

config BOARD_SOPHOS_XG230_REV2
	bool "XG230 Rev 2"
```
